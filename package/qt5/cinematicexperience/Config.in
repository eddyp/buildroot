## package/qt5/cinematicexperience/Config.in
```kconfig
config BR2_PACKAGE_CINEMATICEXPERIENCE
	bool "cinematicexperience"
	select BR2_PACKAGE_QT5GRAPHICALEFFECTS
	depends on BR2_PACKAGE_QT5_GL_AVAILABLE
```
